VERSION "Generated from can_ids.h for IEEE-754 float32 Hydrogreen 2025"

NS_ :

BS_ :

BU_: MASTER LOGGER

BO_ 256 CAN_ID_TIME: 8 MASTER
 SG_ CAN_ID_TIME_VALUE : 0|32@1+ (1,0) [0|4.294967e9] "s" LOGGER

BO_ 257 CAN_ID_TIME_BEFORE_TRANSMIT: 8 MASTER
 SG_ CAN_ID_TIME_BEFORE_TRANSMIT_VALUE : 0|32@1+ (1,0) [0|10.0] "s" LOGGER

BO_ 258 CAN_ID_ACC_BATTERY_VOLTAGE: 8 MASTER
 SG_ CAN_ID_ACC_BATTERY_VOLTAGE_VALUE : 0|32@1+ (1,0) [0|30] "V" LOGGER

BO_ 259 CAN_ID_ACC_BATTERY_CURRENT: 8 MASTER
 SG_ CAN_ID_ACC_BATTERY_CURRENT_VALUE : 0|32@1+ (1,0) [-100|100] "A" LOGGER

BO_ 260 CAN_ID_FC_OUTPUT_VOLTAGE: 8 MASTER
 SG_ CAN_ID_FC_OUTPUT_VOLTAGE_VALUE : 0|32@1+ (1,0) [0|100] "V" LOGGER

BO_ 261 CAN_ID_FC_OUTPUT_CURRENT: 8 MASTER
 SG_ CAN_ID_FC_OUTPUT_CURRENT_VALUE : 0|32@1+ (1,0) [-100|100] "A" LOGGER

BO_ 262 CAN_ID_SC_VOLTAGE: 8 MASTER
 SG_ CAN_ID_SC_VOLTAGE_VALUE : 0|32@1+ (1,0) [0|100] "V" LOGGER

BO_ 263 CAN_ID_SC_CURRENT: 8 MASTER
 SG_ CAN_ID_SC_CURRENT_VALUE : 0|32@1+ (1,0) [-100|100] "A" LOGGER

BO_ 264 CAN_ID_MC_SUPPLY_VOLTAGE: 8 MASTER
 SG_ CAN_ID_MC_SUPPLY_VOLTAGE_VALUE : 0|32@1+ (1,0) [0|100] "V" LOGGER

BO_ 265 CAN_ID_MC_SUPPLY_CURRENT: 8 MASTER
 SG_ CAN_ID_MC_SUPPLY_CURRENT_VALUE : 0|32@1+ (1,0) [-100|100] "A" LOGGER

BO_ 266 CAN_ID_FC_ENERGY_ACCUMULATED: 8 MASTER
 SG_ CAN_ID_FC_ENERGY_ACCUMULATED_VALUE : 0|32@1+ (1,0) [0|1.0e9] "Wh" LOGGER

BO_ 267 CAN_ID_H2_PRESSURE_LOW: 8 MASTER
 SG_ CAN_ID_H2_PRESSURE_LOW_VALUE : 0|32@1+ (1,0) [0|10] "bar" LOGGER

BO_ 268 CAN_ID_H2_PRESSURE_FUEL_CELL: 8 MASTER
 SG_ CAN_ID_H2_PRESSURE_FUEL_CELL_VALUE : 0|32@1+ (1,0) [0|10] "bar" LOGGER

BO_ 269 CAN_ID_H2_PRESSURE_HIGH: 8 MASTER
 SG_ CAN_ID_H2_PRESSURE_HIGH_VALUE : 0|32@1+ (1,0) [0|300] "bar" LOGGER

BO_ 270 CAN_ID_H2_LEAKAGE_SENSOR_VOLTAGE: 8 MASTER
 SG_ CAN_ID_H2_LEAKAGE_SENSOR_VOLTAGE_VALUE : 0|32@1+ (1,0) [0|5] "V" LOGGER

BO_ 271 CAN_ID_FAN_DUTY_CYCLE: 8 MASTER
 SG_ CAN_ID_FAN_DUTY_CYCLE_VALUE : 0|32@1+ (1,0) [0|100] "%" LOGGER

BO_ 272 CAN_ID_BLOWER_DUTY_CYCLE: 8 MASTER
 SG_ CAN_ID_BLOWER_DUTY_CYCLE_VALUE : 0|32@1+ (1,0) [0|100] "%" LOGGER

BO_ 273 CAN_ID_TEMP_FC_LOC1: 8 MASTER
 SG_ CAN_ID_TEMP_FC_LOC1_VALUE : 0|32@1+ (1,0) [-40|200] "degC" LOGGER

BO_ 274 CAN_ID_TEMP_FC_LOC2: 8 MASTER
 SG_ CAN_ID_TEMP_FC_LOC2_VALUE : 0|32@1+ (1,0) [-40|200] "degC" LOGGER

BO_ 275 CAN_ID_ACCEL_PEDAL_VOLTAGE: 8 MASTER
 SG_ CAN_ID_ACCEL_PEDAL_VOLTAGE_VALUE : 0|32@1+ (1,0) [0|5] "V" LOGGER

BO_ 276 CAN_ID_BRAKE_PEDAL_VOLTAGE: 8 MASTER
 SG_ CAN_ID_BRAKE_PEDAL_VOLTAGE_VALUE : 0|32@1+ (1,0) [0|5] "V" LOGGER

BO_ 277 CAN_ID_ACCEL_OUTPUT_VOLTAGE: 8 MASTER
 SG_ CAN_ID_ACCEL_OUTPUT_VOLTAGE_VALUE : 0|32@1+ (1,0) [0|5] "V" LOGGER

BO_ 278 CAN_ID_BRAKE_OUTPUT_VOLTAGE: 8 MASTER
 SG_ CAN_ID_BRAKE_OUTPUT_VOLTAGE_VALUE : 0|32@1+ (1,0) [0|5] "V" LOGGER

BO_ 279 CAN_ID_BUTTONS_MASTER_MASK: 8 MASTER
 SG_ CAN_ID_BUTTONS_MASTER_MASK_VALUE : 0|32@1+ (1,0) [0|4.294967e9] "" LOGGER

BO_ 280 CAN_ID_BUTTONS_STEERING_MASK: 8 MASTER
 SG_ CAN_ID_BUTTONS_STEERING_MASK_VALUE : 0|32@1+ (1,0) [0|4.294967e9] "" LOGGER

BO_ 281 CAN_ID_SENSOR_RPM: 8 MASTER
 SG_ CAN_ID_SENSOR_RPM_VALUE : 0|32@1+ (1,0) [0|6000] "rpm" LOGGER

BO_ 282 CAN_ID_SENSOR_SPEED: 8 MASTER
 SG_ CAN_ID_SENSOR_SPEED_VALUE : 0|32@1+ (1,0) [0|50] "km/h" LOGGER

BO_ 283 CAN_ID_LAP_NUMBER: 8 MASTER
 SG_ CAN_ID_LAP_NUMBER_VALUE : 0|32@1+ (1,0) [0|1000] "" LOGGER

BO_ 284 CAN_ID_LAP_TIME: 8 MASTER
 SG_ CAN_ID_LAP_TIME_VALUE : 0|32@1+ (1,0) [0|4000] "s" LOGGER

BO_ 285 CAN_ID_GPS_ALTITUDE: 8 MASTER
 SG_ CAN_ID_GPS_ALTITUDE_VALUE : 0|32@1+ (1,0) [-500|1000] "m" LOGGER

BO_ 286 CAN_ID_GPS_LATITUDE: 8 MASTER
 SG_ CAN_ID_GPS_LATITUDE_VALUE : 0|32@1+ (1,0) [-90|90] "deg" LOGGER

BO_ 287 CAN_ID_GPS_LONGITUDE: 8 MASTER
 SG_ CAN_ID_GPS_LONGITUDE_VALUE : 0|32@1+ (1,0) [-180|180] "deg" LOGGER

BO_ 288 CAN_ID_GPS_SPEED: 8 MASTER
 SG_ CAN_ID_GPS_SPEED_VALUE : 0|32@1+ (1,0) [0|60] "km/h" LOGGER

BO_ 289 CAN_ID_MASTER_STATE: 8 MASTER
 SG_ CAN_ID_MASTER_STATE_VALUE : 0|32@1+ (1,0) [0|10] "" LOGGER

BO_ 290 CAN_ID_PROTIUM_STATE: 8 MASTER
 SG_ CAN_ID_PROTIUM_STATE_VALUE : 0|32@1+ (1,0) [0|10] "" LOGGER

BO_ 291 CAN_ID_MAIN_VALVE_ENABLE_OUTPUT: 8 MASTER
 SG_ CAN_ID_MAIN_VALVE_ENABLE_OUTPUT_VALUE : 0|32@1+ (1,0) [0|1] "" LOGGER

BO_ 292 CAN_ID_MC_ENABLE_OUTPUT: 8 MASTER
 SG_ CAN_ID_MC_ENABLE_OUTPUT_VALUE : 0|32@1+ (1,0) [0|1] "" LOGGER

SIG_VALTYPE_ 256 CAN_ID_TIME_VALUE : 1;
SIG_VALTYPE_ 257 CAN_ID_TIME_BEFORE_TRANSMIT_VALUE : 1;
SIG_VALTYPE_ 258 CAN_ID_ACC_BATTERY_VOLTAGE_VALUE : 1;
SIG_VALTYPE_ 259 CAN_ID_ACC_BATTERY_CURRENT_VALUE : 1;
SIG_VALTYPE_ 260 CAN_ID_FC_OUTPUT_VOLTAGE_VALUE : 1;
SIG_VALTYPE_ 261 CAN_ID_FC_OUTPUT_CURRENT_VALUE : 1;
SIG_VALTYPE_ 262 CAN_ID_SC_VOLTAGE_VALUE : 1;
SIG_VALTYPE_ 263 CAN_ID_SC_CURRENT_VALUE : 1;
SIG_VALTYPE_ 264 CAN_ID_MC_SUPPLY_VOLTAGE_VALUE : 1;
SIG_VALTYPE_ 265 CAN_ID_MC_SUPPLY_CURRENT_VALUE : 1;
SIG_VALTYPE_ 266 CAN_ID_FC_ENERGY_ACCUMULATED_VALUE : 1;
SIG_VALTYPE_ 267 CAN_ID_H2_PRESSURE_LOW_VALUE : 1;
SIG_VALTYPE_ 268 CAN_ID_H2_PRESSURE_FUEL_CELL_VALUE : 1;
SIG_VALTYPE_ 269 CAN_ID_H2_PRESSURE_HIGH_VALUE : 1;
SIG_VALTYPE_ 270 CAN_ID_H2_LEAKAGE_SENSOR_VOLTAGE_VALUE : 1;
SIG_VALTYPE_ 271 CAN_ID_FAN_DUTY_CYCLE_VALUE : 1;
SIG_VALTYPE_ 272 CAN_ID_BLOWER_DUTY_CYCLE_VALUE : 1;
SIG_VALTYPE_ 273 CAN_ID_TEMP_FC_LOC1_VALUE : 1;
SIG_VALTYPE_ 274 CAN_ID_TEMP_FC_LOC2_VALUE : 1;
SIG_VALTYPE_ 275 CAN_ID_ACCEL_PEDAL_VOLTAGE_VALUE : 1;
SIG_VALTYPE_ 276 CAN_ID_BRAKE_PEDAL_VOLTAGE_VALUE : 1;
SIG_VALTYPE_ 277 CAN_ID_ACCEL_OUTPUT_VOLTAGE_VALUE : 1;
SIG_VALTYPE_ 278 CAN_ID_BRAKE_OUTPUT_VOLTAGE_VALUE : 1;
SIG_VALTYPE_ 279 CAN_ID_BUTTONS_MASTER_MASK_VALUE : 1;
SIG_VALTYPE_ 280 CAN_ID_BUTTONS_STEERING_MASK_VALUE : 1;
SIG_VALTYPE_ 281 CAN_ID_SENSOR_RPM_VALUE : 1;
SIG_VALTYPE_ 282 CAN_ID_SENSOR_SPEED_VALUE : 1;
SIG_VALTYPE_ 283 CAN_ID_LAP_NUMBER_VALUE : 1;
SIG_VALTYPE_ 284 CAN_ID_LAP_TIME_VALUE : 1;
SIG_VALTYPE_ 285 CAN_ID_GPS_ALTITUDE_VALUE : 1;
SIG_VALTYPE_ 286 CAN_ID_GPS_LATITUDE_VALUE : 1;
SIG_VALTYPE_ 287 CAN_ID_GPS_LONGITUDE_VALUE : 1;
SIG_VALTYPE_ 288 CAN_ID_GPS_SPEED_VALUE : 1;
SIG_VALTYPE_ 289 CAN_ID_MASTER_STATE_VALUE : 1;
SIG_VALTYPE_ 290 CAN_ID_PROTIUM_STATE_VALUE : 1;
SIG_VALTYPE_ 291 CAN_ID_MAIN_VALVE_ENABLE_OUTPUT_VALUE : 1;
SIG_VALTYPE_ 292 CAN_ID_MC_ENABLE_OUTPUT_VALUE : 1;
